## config/boards/shields/skeletyl_v2_elitec/Kconfig.defconfig
```kconfig
# Copyright (c) 2022 ZMK Contributors
# SPDX-License-Identifier: MIT
 

CONFIG_ZMK_IDLE_TIMEOUT=7000
CONFIG_ZMK_SLEEP=y
CONFIG_ZMK_IDLE_SLEEP_TIMEOUT=80000


if SHIELD_SKELETYL_LEFT

config ZMK_KEYBOARD_NAME
	default "bmk"

config ZMK_SPLIT_BLE_ROLE_CENTRAL
	default y

endif

if SHIELD_SKELETYL_RIGHT

config ZMK_KEYBOARD_NAME
	default "Skeletyl Right"

endif

if SHIELD_SKELETYL_LEFT || SHIELD_SKELETYL_RIGHT

config ZMK_SPLIT
	default y
	
endif
```
