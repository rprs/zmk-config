/*
 * Copyright (c) 2020 ZMK Contributors
 *
 * SPDX-License-Identifier: MIT
 */

#include "skeletyl_v2_elitec.dtsi"

&kscan0 {
	col-gpios
		= <&pro_micro 20 (GPIO_ACTIVE_HIGH | GPIO_PULL_DOWN)>
		, <&pro_micro 13 (GPIO_ACTIVE_HIGH | GPIO_PULL_DOWN)>
		, <&pro_micro  10 (GPIO_ACTIVE_HIGH | GPIO_PULL_DOWN)>
		, <&pro_micro  11 (GPIO_ACTIVE_HIGH | GPIO_PULL_DOWN)>
		, <&pro_micro  12 (GPIO_ACTIVE_HIGH | GPIO_PULL_DOWN)>
		;
};